## CMakeLists.txt
```
cmake_minimum_required(VERSION 3.20.0)

list(APPEND BOARD_ROOT ${CMAKE_CURRENT_SOURCE_DIR})
find_package(Zephyr REQUIRED HINTS $ENV{ZEPHYR_BASE})
project(my_zephyr_app)

target_sources(app PRIVATE src/main.cpp)
target_sources(app PRIVATE src/led_sensor.c)
target_sources(app PRIVATE src/led_sensor_shell.c)
```

## Kconfig
```
config APP_HEARTBEAT_PERIOD_MS 
int "APP_HEARTBEAT_PERIOD_MS (100-2000)"
default 500
range 100 2000


source "Kconfig.zephyr"
```

## prj.conf
```kconfig
#CONFIG_GPIO=y
#CONFIG_LOG=y

#CONFIG_BLINK_SLEEP_250MS=y
#CONFIG_BLINK_SLEEP_TIME_MS=2000 .> wrong , error

CONFIG_SENSOR=y
CONFIG_GPIO=y
CONFIG_PRINTK=y
CONFIG_PRINTK_SYNC=y

# Enable Zephyr Shell Subsystem
CONFIG_SHELL=y
CONFIG_SENSOR_SHELL=n  # Disable factory sensor shell to prevent command name conflicts


# Route the Interactive Shell directly into your current terminal 
CONFIG_UART_NATIVE_PTY_0_ON_STDINOUT=y
```

## app.overlay
```dts
// /{
//     aliases {
//           //app-led = &led_0;// by node label
//           app-led  = "/leds/led_0";// by path
//         };
// };
//
#include <zephyr/dt-bindings/gpio/gpio.h>

/ {
    my_led_sensor: led_sensor_0 {
        compatible = "our,led-sensor";
        /* Connect to virtual gpio0, pin 0, active high flag */
        led-gpios = <&gpio0 0 GPIO_ACTIVE_HIGH>;
        status = "okay";
    };
};
```

## dts/bindings/our,led-sensor.yaml
```yaml
description: Custom LED Sensor Driver simulating sensor APIs
compatible: "our,led-sensor"

include: base.yaml

properties:
  led-gpios:
    type: phandle-array
    required: true
    description: GPIO specifier linking to the target simulation LED pin.
```

## src/main.cpp
```c
// #include <zephyr/drivers/gpio.h>
// #include <zephyr/kernel.h>
// #include <zephyr/logging/log.h>

// //#define SLEEP_TIME_MS 1000

// /* The devicetree node identifier for the "led0" alias. */
// //#define LED_NODE DT_ALIAS(led0)
// #define LED_NODE DT_ALIAS(app_led)

// static const struct gpio_dt_spec led = GPIO_DT_SPEC_GET(LED_NODE, gpios);

// LOG_MODULE_REGISTER(main, LOG_LEVEL_INF);

// int main(void)
// {
//     bool led_state = true;

//     if (!gpio_is_ready_dt(&led)) return 0;

//     if (gpio_pin_configure_dt(&led, GPIO_OUTPUT_ACTIVE) < 0) return 0;

//     while (1) {
//         if (gpio_pin_toggle_dt(&led) < 0) return 0;

//         led_state = !led_state;
//         LOG_INF("LED state: %s", led_state ? "ON" : "OFF");
//         //k_msleep(SLEEP_TIME_MS);
//         //k_msleep(CONFIG_BLINK_SLEEP_TIME_MS);
//         k_msleep(CONFIG_APP_HEARTBEAT_PERIOD_MS);
//     }
//     return 0;
// }

// #include <stdio.h>
// #include <zephyr/kernel.h>
// #include <zephyr/sys/printk.h>


// int main(void)
// {
// 	printk("Hello World! %s\n", CONFIG_BOARD_TARGET);


// 	return 0;
// }

// #include <zephyr/kernel.h>
// #include <zephyr/device.h>
// #include <zephyr/drivers/sensor.h>
// #include "led_sensor.h"  // Include our custom extension header

// int main(void)
// {
//     const struct device *dev = DEVICE_DT_GET(DT_NODELABEL(my_led_sensor));

//     if (!device_is_ready(dev)) {
//         printk("Custom LED Sensor driver device not ready!\n");
//         return -ENODEV;
//     }

//     printk("=== Native Sim Extension API Test Started ===\n");

//     // 1. Initial run showing the default initialized parameter state (100)
//     sensor_sample_fetch(dev);
//     k_msleep(500);
//     struct sensor_value dummy;
//     sensor_channel_get(dev, SENSOR_CHAN_ALL, &dummy);
//     k_msleep(500);

//     // 2. Call custom extension API function to change the runtime parameter value to 555
//     led_sensor_set_custom_parameter(dev, 555);

//     // 3. Next run to prove that the parameter inside the driver's structural data block updated successfully
//     sensor_sample_fetch(dev);
//     k_msleep(500);
//     sensor_channel_get(dev, SENSOR_CHAN_ALL, &dummy);

//     printk("=== Extension API Test Completed Natively ===\n");
//     return 0;

//     //Task : l7-task1
//         /* Infinite loop keeps main thread alive so you can still use the interactive shell console */
//     while (1) {
//         k_sleep(K_FOREVER);
//     }
//     return 0;
// }


#include <zephyr/kernel.h>

int main(void)
{
    // The interactive shell subsystem runs on a separate background thread automatically.
    while (1) {
        k_sleep(K_FOREVER);
    }
    return 0;
}
```

## src/led_sensor.c
```c
#define DT_DRV_COMPAT our_led_sensor  // Matches compatible: "our,led-sensor"

#include <zephyr/kernel.h>
#include <zephyr/device.h>
#include <zephyr/drivers/gpio.h>
#include <zephyr/drivers/sensor.h>
#include "led_sensor.h"  // Include our custom API interface header

/* Constant configuration struct (Stored in Flash memory) */
struct led_sensor_config {
    struct gpio_dt_spec led_gpio;
};

/* Dynamic data struct for mutable runtime parameters (Stored in RAM) */
struct led_sensor_data {
    int custom_param;  // The parameter to be modified by our custom extension API
};

/* Implementation of the Custom Extension API Function */
void led_sensor_set_custom_parameter(const struct device *dev, int new_val)
{
    // Retrieve the dynamic runtime data pointer out of the generic device instance
    struct led_sensor_data *data = (struct led_sensor_data *)dev->data;

    // Modify the variable in the dynamic data struct
    data->custom_param = new_val;

    printk("[CUSTOM API LOG] led_sensor_set_custom_parameter executed! New data->custom_param value = %d\n", 
           data->custom_param);
}

/* Standard sample_fetch: Turns the LED ON */
static int led_sensor_sample_fetch(const struct device *dev, enum sensor_channel chan)
{
    const struct led_sensor_config *cfg = dev->config;
    const struct led_sensor_data *data = dev->data; // Read data if needed
    
    int ret = gpio_pin_set_dt(&cfg->led_gpio, 1);
    if (ret == 0) {
        printk("[DRIVER LOG] sample_fetch called (Current param = %d) -> LED ON!\n", data->custom_param);
    }
    return ret;
}

/* Standard channel_get: Turns the LED OFF */
static int led_sensor_channel_get(const struct device *dev, enum sensor_channel chan, struct sensor_value *val)
{
    const struct led_sensor_config *cfg = dev->config;

    int ret = gpio_pin_set_dt(&cfg->led_gpio, 0);
    if (ret == 0) {
        printk("[DRIVER LOG] channel_get called -> LED OFF!\n");
    }
    return ret;
}

static DEVICE_API(sensor, led_sensor_api) = {
    .sample_fetch = led_sensor_sample_fetch,
    .channel_get = led_sensor_channel_get,
};

static int led_sensor_init(const struct device *dev)
{
    const struct led_sensor_config *cfg = dev->config;
    struct led_sensor_data *data = dev->data;

    // Set a baseline starting value inside our dynamic data parameter
    data->custom_param = 100;

    if (!gpio_is_ready_dt(&cfg->led_gpio)) {
        return -ENODEV;
    }

    return gpio_pin_configure_dt(&cfg->led_gpio, GPIO_OUTPUT_INACTIVE);
}

/* Updated Macro: Passes the runtime data structure references into the definition layout */
#define LED_SENSOR_DEFINE(inst)                                        \
    static struct led_sensor_data led_sensor_data_##inst;              \
    static const struct led_sensor_config led_sensor_config_##inst = { \
        .led_gpio = GPIO_DT_SPEC_INST_GET(inst, led_gpios),           \
    };                                                                 \
                                                                       \
    DEVICE_DT_INST_DEFINE(inst,                                        \
                          led_sensor_init,                             \
                          NULL,                                        \
                          &led_sensor_data_##inst,                     \
                          &led_sensor_config_##inst,                   \
                          POST_KERNEL,                                 \
                          CONFIG_SENSOR_INIT_PRIORITY,                 \
                          &led_sensor_api);

DT_INST_FOREACH_STATUS_OKAY(LED_SENSOR_DEFINE)
```

## src/led_sensor.h
```c
#ifndef OUR_LED_SENSOR_H_
#define OUR_LED_SENSOR_H_

#include <zephyr/device.h>

#ifdef __cplusplus
extern "C" {
#endif

/**
 * @brief Custom driver extension API to update a dynamic runtime parameter.
 * 
 * @param dev Pointer to the custom sensor device instance.
 * @param new_val The new integer configuration value to save in the data struct.
 */
void led_sensor_set_custom_parameter(const struct device *dev, int new_val);

#ifdef __cplusplus
}
#endif

#endif /* OUR_LED_SENSOR_H_ */
```

## src/led_sensor_shell.c
```c
#include <zephyr/kernel.h>
#include <zephyr/device.h>
#include <zephyr/drivers/sensor.h>
#include <zephyr/shell/shell.h>
#include "led_sensor.h"  // Include our custom API interface header

/* Helper to safely retrieve our device instance inside shell callbacks */
static const struct device *get_sensor_device(void)
{
    return DEVICE_DT_GET(DT_NODELABEL(my_led_sensor));
}

/* 1. Subcommand: fetch */
static int cmd_fetch(const struct shell *sh, size_t argc, char **argv)
{
    const struct device *dev = get_sensor_device();

    if (!device_is_ready(dev)) {
        shell_error(sh, "Sensor device not ready!");
        return -ENODEV;
    }

    shell_print(sh, "Executing sensor_sample_fetch() via shell...");
    int ret = sensor_sample_fetch(dev);
    if (ret == 0) {
        shell_print(sh, "Fetch success!");
    } else {
        shell_error(sh, "Fetch failed with error: %d", ret);
    }
    return ret;
}

/* 2. Subcommand: read */
static int cmd_read(const struct shell *sh, size_t argc, char **argv)
{
    const struct device *dev = get_sensor_device();
    struct sensor_value val = {0};

    if (!device_is_ready(dev)) {
        shell_error(sh, "Sensor device not ready!");
        return -ENODEV;
    }

    shell_print(sh, "Executing sensor_channel_get() via shell...");
    int ret = sensor_channel_get(dev, SENSOR_CHAN_ALL, &val);
    if (ret == 0) {
        shell_print(sh, "Read Success! LED turned OFF.");
    } else {
        shell_error(sh, "Read failed with error: %d", ret);
    }
    return ret;
}

/* 3. Subcommand: info */
static int cmd_info(const struct shell *sh, size_t argc, char **argv)
{
    const struct device *dev = get_sensor_device();
    bool ready = device_is_ready(dev);

    shell_print(sh, "Device Name:  %s", dev->name);
    shell_print(sh, "Ready State:  %s", ready ? "READY" : "NOT READY");
    return 0;
}

/* 4. New Subcommand with Argument Validation: set <value> */
static int cmd_set(const struct shell *sh, size_t argc, char **argv)
{
    const struct device *dev = get_sensor_device();

    if (!device_is_ready(dev)) {
        shell_error(sh, "Sensor device not ready!");
        return -ENODEV;
    }

    // Convert string parameter to integer
    int value = atoi(argv[1]);

    // Validate if the input value falls out of a specified safe range (e.g., 0 to 1000)
    if (value < 0 || value > 1000) {
        shell_error(sh, "Error: Value %d is out of range! (Allowed range: 0 - 1000)", value);
        return -EINVAL;
    }

    shell_print(sh, "Setting custom parameter to: %d", value);
    
    // Invoking my custom Extension API from L06 Task 2
    led_sensor_set_custom_parameter(dev, value);
    
    shell_print(sh, "Parameter successfully updated in dynamic data struct.");
    return 0;
}

/* Create the static subcommand array tree structure */
SHELL_STATIC_SUBCMD_SET_CREATE(sub_sensor,
    SHELL_CMD(fetch, NULL, "Trigger sensor_sample_fetch() -> Turn LED ON", cmd_fetch),
    SHELL_CMD(read,  NULL, "Trigger sensor_channel_get()  -> Turn LED OFF", cmd_read),
    SHELL_CMD(info,  NULL, "Print hardware device name and ready status", cmd_info),


    /* Enforce argument counts using SHELL_CMD_ARG:
     * mandatory arguments = 2 (the keyword "set" + the value parameter)
     * optional arguments  = 0
     */
    SHELL_CMD_ARG(set, NULL, "Set dynamic data parameter <value> (Range: 0-1000)", cmd_set, 2, 0),

    SHELL_SUBCMD_SET_END
);

/* Register the main root level command 'sensor' linked to your subcommands */
SHELL_CMD_REGISTER(sensor, &sub_sensor, "Custom LED Sensor driver control panel", NULL);
```
