## app/boards/custom/ahmed_qemu_board/Kconfig
```kconfig
# Copyright (c) 2016 Zephyr Contributors
# SPDX-License-Identifier: Apache-2.0

config BOARD_AHMED_QEMU_BOARD
	select QEMU_TARGET
```

## app/boards/custom/ahmed_qemu_board/Kconfig.ahmed_qemu_board
```kconfig
# Copyright (c) 2016 Zephyr Contributors
# SPDX-License-Identifier: Apache-2.0

config BOARD_AHMED_QEMU_BOARD
	select SOC_TI_LM3S6965
	help
	  Cortex-M3 Emulation (QEMU)
```

## app/boards/custom/ahmed_qemu_board/board.yml
```yaml
board:
  name: ahmed_qemu_board
  full_name: QEMU Emulation for ARM Cortex-M3
  vendor: qemu
  socs:
  - name: ti_lm3s6965
```

## app/boards/custom/scratch_qemu_board/Kconfig.scratch_qemu_board
```kconfig
# Copyright (c) 2016 Zephyr Contributors
# SPDX-License-Identifier: Apache-2.0

config BOARD_SCRATCH_QEMU_BOARD
	select SOC_TI_LM3S6965
	help
	  Cortex-M3 Emulation (QEMU)
```
